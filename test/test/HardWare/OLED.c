#include "OLED.h"
/*
PB8 ---- IIC_SCL
PB9 ---- IIC_SDA
*/


const unsigned char HZK16[14][32] = {
    {0x10,0x60,0x02,0x8C,0x20,0x18,0x08,0x08,0x88,0x7F,0x88,0x08,0x28,0x18,0x08,0x00,0x04,0x04,0x7E,0x01,0x80,0x40,0x30,0x0C,0x03,0x00,0x3F,0x40,0x40,0x40,0x70,0x00},/*"沈",0*/
    {0x00,0xFE,0x02,0x22,0xDA,0x06,0x00,0xFC,0x04,0x04,0x04,0x04,0x04,0xFC,0x00,0x00,0x00,0xFF,0x08,0x10,0x08,0x07,0x00,0xFF,0x41,0x41,0x41,0x41,0x41,0xFF,0x00,0x00},/*"阳",1*/
    {0x40,0x40,0xC0,0x5F,0x55,0x55,0xD5,0x55,0x55,0x55,0x55,0x5F,0x40,0x40,0x40,0x00,0x20,0x60,0x3F,0x25,0x15,0x15,0xFF,0x90,0x47,0x29,0x11,0x2D,0x43,0x80,0x80,0x00},/*"最",2*/
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		{0x40,0x40,0x42,0x42,0x42,0x42,0x42,0xFE,0x42,0x42,0x42,0x42,0x42,0x40,0x40,0x00,0x80,0x80,0x40,0x20,0x10,0x0C,0x03,0x00,0x03,0x0C,0x10,0x20,0x40,0x80,0x80,0x00},/*"天",13*/
			
};



// 沈(0) 阳(1) 天(2) 气(3) 室(4) 外(5) 温(6) 度(7) 湿(8) 度(9) 最(10) 高(11) 低(12) 晴(13) 多(14) 云(15)
// 雷(16) 阵(17) 雨(18) 大(19) 中(20) 小(21) 阴(22) 转(23) 强(24) 有(25) 特(26) 雪(27) 夹(28) 雾(29) 霾(30) 中(31)
// 度(32) 重(33) 严(34)
const unsigned char HZK17[36][32] = {
{0x10,0x60,0x02,0x8C,0x20,0x18,0x08,0x08,0x88,0x7F,0x88,0x08,0x28,0x18,0x08,0x00,0x04,0x04,0x7E,0x01,0x80,0x40,0x30,0x0C,0x03,0x00,0x3F,0x40,0x40,0x40,0x70,0x00},/*"沈",0*/
{0x00,0xFE,0x02,0x22,0xDA,0x06,0x00,0xFC,0x04,0x04,0x04,0x04,0x04,0xFC,0x00,0x00,0x00,0xFF,0x08,0x10,0x08,0x07,0x00,0xFF,0x41,0x41,0x41,0x41,0x41,0xFF,0x00,0x00},/*"阳",1*/
{0x40,0x40,0x42,0x42,0x42,0x42,0x42,0xFE,0x42,0x42,0x42,0x42,0x42,0x40,0x40,0x00,0x80,0x80,0x40,0x20,0x10,0x0C,0x03,0x00,0x03,0x0C,0x10,0x20,0x40,0x80,0x80,0x00},/*"天",2*/
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{0x06,0x09,0x09,0xE6,0xF8,0x0C,0x04,0x02,0x02,0x02,0x02,0x02,0x04,0x1E,0x00,0x00,0x00,0x00,0x00,0x07,0x1F,0x30,0x20,0x40,0x40,0x40,0x40,0x40,0x20,0x10,0x00,0x00},/*"℃",35*/
};

static uint8_t OLED_GRAM[8][128];  //显存在单片机的内容






//发送一个字节
//向SSD1306写入一个字节。
//mode:数据/命令标志 0,表示命令;1,表示数据;
uint8_t OLED_WR_Data(u8 dat[],uint16_t len,u8 mode)
{
	uint16_t i;

	//1.发送起始信号
	if(i2c1_start() != 0)
	{
		printf("write i2c1_start()  failed\n");
		return 254;
	}

	//2.发送设备地址
	if(i2c1_put_devaddr(OLED_DEV_ADDR)!= 0)   //最低位是0，表示写操作
	{
		printf("write i2c1_put_devaddr failed\n");
		return 253;
	}

	//4.发送模式，mode可能是命令，也可能是数据
	i2c1_put_byte_data(mode);  
	
	//3.读ack
	if(i2c1_get_ack())  //如果没有应答，直接退出
	{
		printf("mode error \n");
		i2c1_stop();     //发送停止信号，总线就空闲了
		return 2;
	}

	for(i=0;i<len;i++)
	{			
		//4.发送内容
		i2c1_put_byte_data(dat[i]); 

		//3.读ack
		if(i2c1_get_ack())  //如果没有应答，直接退出
		{
			i2c1_stop();     //发送停止信号，总线就空闲了
			return 3;
		}
	}

	//5.结束，结束总线的占用
	i2c1_stop();
	Delay_ms(100);	
	

	return 0;
}




//更新显存到OLED	
void OLED_Refresh(void)
{
	OLED_WR_Data((void*)OLED_GRAM,sizeof OLED_GRAM,OLED_DATA);

}


//清屏函数
void OLED_Clear(void)
{
	u8 i,n;

	for(i=0;i<8;i++)
	{
		for(n=0;n<128;n++)
		{
			 OLED_GRAM[i][n]=0x00;//清除所有数据
		}
	}
	OLED_Refresh();//更新显示
}



void OLED_ShowChinese(u8 x, u8 y, u8 index)
{
    u8 i, j;
    const u8 *temp = HZK17[index];  // 从字模数组中获取字模数据

    for (j = 0; j < 2; j++)
    {
        for (i = 0; i < 16; i++)
        {
            OLED_GRAM[y / 8 + j][x + i] = temp[i + j * 16];
        }
    }
    OLED_Refresh();  // 更新显示
}


//unsigned char getChineseIndex(const unsigned char *str)
//{
//    // 假设字库中的汉字按顺序排列，对应字库的索引
//    // 比如沈阳最高低气温℃晴多云阴雨
//    // 沈 = 0, 阳 = 1, 最 = 2, 高 = 3, 低 = 4, 气 = 5, 温 = 6, ℃ = 7, 晴 = 8, 多 = 9, 云 = 10, 阴 = 11, 雨 = 12

//    // 对应的汉字序列
//   const char *chineseList[] = {
//    "沈", "阳", "天", "气", "室", "外", "温", "度", "湿", "度",
//    "最", "高", "低", "晴", "多", "云", "雷", "阵", "雨", "大",
//    "中", "小", "阴", "转", "强", "有", "特", "雪", "夹", "雾",
//    "霾", "中", "度", "重", "严"
//};

//    // 提取输入的汉字
//    char inputChar[3];
//    inputChar[0] = str[0];
//    inputChar[1] = str[1];
//    inputChar[2] = '\0';

//    // 查找汉字在字库中的索引
//    for (unsigned char i = 0; i < sizeof(chineseList)/sizeof(chineseList[0]); i++)
//    {
//        if (strcmp((const char*)inputChar, chineseList[i]) == 0)
//        {
//            return i;  // 返回汉字在字库中的索引
//        }
//    }

//    return 0xFF;  // 如果没有找到，返回一个无效索引
//}

unsigned char getChineseIndex(const unsigned char *str) // 16进制晴
{
    // 假设字库中的汉字按顺序排列，对应字库的索引
    // 比如沈阳最高低气温℃晴多云阴雨
    // 沈 = 0, 阳 = 1, 最 = 2, 高 = 3, 低 = 4, 气 = 5, 温 = 6, ℃ = 7, 晴 = 8, 多 = 9, 云 = 10, 阴 = 11, 雨 = 12

    // 对应的汉字序列 (UTF-8 encoded)
    const char *chineseList[] = {
        "沈", "阳", "天", "气", "室", "外", "温", "度", "湿", "度",
        "最", "高", "低", "晴", "多", "云", "雷", "阵", "雨", "大",
        "中", "小", "阴", "转", "强", "有", "特", "雪", "夹", "雾",
        "霾", "中", "度", "重", "严","℃"
    };

    // 输入的汉字需要与字库中的每个字符比较
    for (unsigned char i = 0; i < sizeof(chineseList) / sizeof(chineseList[0]); i++)
    {
        // 比较整个UTF-8序列
        if (strncmp((const char *)str, chineseList[i], strlen(chineseList[i])) == 0)
        {
            return i;  // 返回汉字在字库中的索引
        }
    }

    return 0xFF;  // 如果没有找到，返回一个无效索引
}



void OLED_ShowChineseString(u8 x, u8 y, const u8 *str)
{
    while (*str != '\0')
    {
        if ((*str & 0x80) == 0)  // 处理ASCII字符
        {
            OLED_ShowChar(x, y, *str, 16);  // 显示ASCII字符
            x += 8;
            str++;
        }
        else  // 处理中文字符
        {
            unsigned char index = getChineseIndex(str);
					//
            OLED_ShowChinese(x, y, index);
            x += 16;
            str += 2;  // 跳过2个字节
        }

        if (x > 128 - 16)
        {
            x = 0;
            y += 16;
        }

        if (y > 64 - 16)
        {
            break;
        }
    }
    OLED_Refresh();  // 更新显示
}

// 假设您只需要支持少量汉字，手动映射
//unsigned char utf8_to_gb2312(const unsigned char *utf8_char)
//{
//    // 这里列出 UTF-8 与 GB2312 的映射表
//    if (strcmp((const char*)utf8_char, "晴") == 0) return 0xA1; // 替换为 GB2312 编码的索引
//    if (strcmp((const char*)utf8_char, "阴") == 0) return 0xA2; // 同上
//    // 添加其他汉字的映射

//    return 0xFF;  // 未找到映射
//}

//void OLED_ShowChineseString(u8 x, u8 y, const u8 *str)
//{
//    while (*str != '\0')
//    {
//        if ((*str & 0x80) == 0)  // 处理ASCII字符
//        {
//            OLED_ShowChar(x, y, *str, 16);  // 显示ASCII字符
//            x += 8;
//            str++;
//        }
//        else  // 处理中文字符
//        {
//            unsigned char gb2312_char = utf8_to_gb2312(str);
//            if (gb2312_char != 0xFF)
//            {
//                unsigned char index = getChineseIndex(&gb2312_char);
//                OLED_ShowChinese(x, y, index);
//                x += 16;
//            }
//            else
//            {
//                // 未找到映射
//                printf("无法映射汉字: %s\n", str);
//            }
//            str += 2;  // 跳过2个字节
//        }

//        if (x > 128 - 16)
//        {
//            x = 0;
//            y += 16;
//        }

//        if (y > 64 - 16)
//        {
//            break;
//        }
//    }
//    OLED_Refresh();  // 更新显示
//}


void oled_init(void)
{
	uint8_t cmd_arr[] = {0xAE,0x00,0x10,0x40,0x81,0xCF,0xA1,0xC8,0xA6,0xA8,
						0x3f,0xD3,0x00,0xd5,0x80,0xD9,0xF1,0xDA,0x12,0xDB,
						0x40,0x20,0x00,0x8D,0x14,0xA4,0xA6,0xAF};
	
	//i2c接口的初始化
	
		i2c1_init();
	OLED_WR_Data(cmd_arr,sizeof cmd_arr,OLED_CMD);

	OLED_Clear();
}






//在指定位置显示一个字符,包括部分字符
//x:0~127
//y:0~63
//size:选择字体 12/16/24
//取模方式 逐列式
void OLED_ShowChar(u8 x,u8 y,u8 chr,u8 size1)
{
	u8 i,j,chr1;
	u8 y0=y/8;

	chr1=chr-' ';  //计算偏移后的值

	for(j=0;j<2;j++)
	{
		for(i=0;i<8;i++)
		{
			OLED_GRAM[y0+j][x+i] = asc2_1608[chr1][i+j*8];
		}
	}
	
}


//显示字符串
//x,y:起点坐标  
//size1:字体大小 
//*chr:字符串起始地址 
void OLED_ShowString(u8 x,u8 y,u8 *chr,u8 size1)
{
//	  u8 startX = x; // 保存起始 x 坐标
//    u8 startY = y; // 保存起始 y 坐标
	
	while((*chr>=' ')&&(*chr<='~'))//判断是不是非法字符!
	{
		OLED_ShowChar(x,y,*chr,size1);

		x+=size1/2;
		if(x>128-size1/2)  //换行
		{
			x=0;
			y+=8;
		}
		chr++;
	}
	
//	  // 填充空格到行尾
//    while(x <= 128 - size1/2)
//    {
//        OLED_ShowChar(x, y, ' ', size1); // 填充空格字符
//        x += size1/2;
//    }

//    // 填充剩余行
//    y += 8;
//    while(y <= 64 - 8)
//    {
//        x = 0;
//        while(x <= 128 - size1/2)
//        {
//            OLED_ShowChar(x, y, ' ', size1); // 填充空格字符
//            x += size1/2;
//        }
//        y += 8;
//    }

	
	
	OLED_Refresh();//更新显示
}

// 将UTF-8编码的字符转换为16进制表示
void utf8ToHex(const char *str, unsigned char *outputHex) {
    size_t len = strlen(str);
    for (size_t i = 0; i < len; i++) {
        outputHex[i] = (unsigned char)str[i];
    }
}

unsigned char get16ChineseIndex(const char *str) {
    const char *chineseList[] = {
        "沈", "阳", "天", "气", "室", "外", "温", "度", "湿", "度",
        "最", "高", "低", "晴", "多", "云", "雷", "阵", "雨", "大",
        "中", "小", "阴", "转", "强", "有", "特", "雪", "夹", "雾",
        "霾", "中", "度", "重", "严"
    };

    unsigned char inputHex[4] = {0};  // 用于存储输入的16进制 UTF-8 编码
    utf8ToHex(str, inputHex);

    for (unsigned char i = 0; i < sizeof(chineseList) / sizeof(chineseList[0]); i++) {
        unsigned char listHex[4] = {0};  // 用于存储字库中汉字的 UTF-8 编码
        utf8ToHex(chineseList[i], listHex);

        if (memcmp(inputHex, listHex, strlen((char *)listHex)) == 0) {
            return i;  // 返回汉字在字库中的索引
        }
    }

    return 0xFF;  // 如果没有找到，返回一个无效索引
}

void OLED_Show16ChineseString(u8 x, u8 y, const char *str) {
    while (*str != '\0') {
        unsigned char index = get16ChineseIndex(str);
        if (index != 0xFF) {
            OLED_ShowChinese(x, y, index);
            x += 16;  // 每个汉字占16像素宽度
            str += 3;  // 跳过3个字节（UTF-8编码的汉字通常占3个字节）
        } else {
            // 处理无效字符
            break;
        }

        if (x > 128 - 16) {  // 检查是否超出屏幕宽度
            x = 0;
            y += 16;
        }

        if (y > 64 - 16) {  // 检查是否超出屏幕高度
            break;
        }
    }
    OLED_Refresh();  // 更新显示
}
